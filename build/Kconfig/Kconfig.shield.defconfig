## build/Kconfig/arch/Kconfig
```kconfig
# Load Zephyr Arch Kconfig descriptions.
osource "/home/gabriel-couto/zephyrproject/zephyr/arch/x86/Kconfig"
osource "/home/gabriel-couto/zephyrproject/zephyr/arch/xtensa/Kconfig"
osource "/home/gabriel-couto/zephyrproject/zephyr/arch/sparc/Kconfig"
osource "/home/gabriel-couto/zephyrproject/zephyr/arch/riscv/Kconfig"
osource "/home/gabriel-couto/zephyrproject/zephyr/arch/posix/Kconfig"
osource "/home/gabriel-couto/zephyrproject/zephyr/arch/nios2/Kconfig"
osource "/home/gabriel-couto/zephyrproject/zephyr/arch/mips/Kconfig"
osource "/home/gabriel-couto/zephyrproject/zephyr/arch/arm64/Kconfig"
osource "/home/gabriel-couto/zephyrproject/zephyr/arch/arm/Kconfig"
osource "/home/gabriel-couto/zephyrproject/zephyr/arch/arc/Kconfig"
```

## build/Kconfig/boards/Kconfig.defconfig
```kconfig
# Load Zephyr board defconfig descriptions.
osource "/home/gabriel-couto/zephyrproject/zephyr/boards/nordic/nrf52840dk/Kconfig.defconfig"
```

## build/Kconfig/boards/Kconfig.sysbuild
```kconfig
# Load Sysbuild board Kconfig descriptions.
osource "/home/gabriel-couto/zephyrproject/zephyr/boards/nordic/nrf52840dk/Kconfig.sysbuild"
```
